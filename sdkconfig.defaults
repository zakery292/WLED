## sdkconfig.defaults
```kconfig
# WLED ESP-IDF SDK Configuration Defaults for ESP32-P4-NANO
# 16MB Flash, 32MB PSRAM, ESP32-C6 WiFi coprocessor

# Target
CONFIG_IDF_TARGET="esp32p4"

# Partition table for 16MB flash
CONFIG_PARTITION_TABLE_CUSTOM=y
CONFIG_PARTITION_TABLE_CUSTOM_FILENAME="partitions_16mb.csv"

# Flash settings - 16MB
CONFIG_ESPTOOLPY_FLASHSIZE_16MB=y
CONFIG_ESPTOOLPY_FLASHMODE_DIO=y
CONFIG_ESPTOOLPY_FLASHFREQ_80M=y

# CPU frequency - P4 runs at 400MHz
CONFIG_ESP_DEFAULT_CPU_FREQ_MHZ_400=y

# Enable PSRAM - P4-NANO has 32MB stacked PSRAM
CONFIG_SPIRAM=y
CONFIG_SPIRAM_MODE_OCT=y
CONFIG_SPIRAM_SPEED_200M=y
CONFIG_SPIRAM_BOOT_INIT=y
CONFIG_SPIRAM_USE_MALLOC=y
CONFIG_SPIRAM_MALLOC_ALWAYSINTERNAL=4096
CONFIG_SPIRAM_MALLOC_RESERVE_INTERNAL=32768
CONFIG_SPIRAM_ALLOW_BSS_SEG_EXTERNAL_MEMORY=y
CONFIG_SPIRAM_ALLOW_STACK_EXTERNAL_MEMORY=y

# Arduino specific settings - we use app_main()
CONFIG_AUTOSTART_ARDUINO=n
CONFIG_FREERTOS_HZ=1000

# ==========================================
# WiFi via ESP32-C6 coprocessor (SDIO hosted)
# ==========================================
# ESP-Hosted enables WiFi 6 through the C6 chip
CONFIG_ESP_WIFI_REMOTE_ENABLED=y
CONFIG_ESP_HOSTED_ENABLED=y
# SDIO interface to C6
CONFIG_ESP_SDIO_HOST_SLOT=1

# ==========================================
# Ethernet - P4 has internal EMAC with IP101GRI
# ==========================================
CONFIG_ETH_USE_ESP32_EMAC=y
CONFIG_ETH_PHY_INTERFACE_RMII=y
CONFIG_ETH_RMII_CLK_INPUT=y
CONFIG_ETH_RMII_CLK_IN_GPIO=50

# Increase main task stack size for WLED
CONFIG_ESP_MAIN_TASK_STACK_SIZE=16384

# Enable mDNS
CONFIG_MDNS_MAX_SERVICES=10

# LittleFS
CONFIG_LITTLEFS_MAX_PARTITIONS=3

# Watchdog
CONFIG_ESP_TASK_WDT_TIMEOUT_S=10
CONFIG_ESP_TASK_WDT_CHECK_IDLE_TASK_CPU0=n

# FreeRTOS
CONFIG_FREERTOS_TIMER_TASK_STACK_DEPTH=4096

# Compiler optimizations
CONFIG_COMPILER_OPTIMIZATION_PERF=y

# HTTP Server
CONFIG_HTTPD_MAX_REQ_HDR_LEN=1024
CONFIG_HTTPD_MAX_URI_LEN=512

# LWIP
CONFIG_LWIP_MAX_SOCKETS=16
CONFIG_LWIP_SO_RCVBUF=y

# Heap
CONFIG_HEAP_POISONING_DISABLED=y
```
